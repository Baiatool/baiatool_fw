## Kconfig.id_manager
```kconfig
module = ID_MANAGER
module-str = id_manager
source "subsys/logging/Kconfig.template.log_config"

menu "ID manager"
    config ID_MANAGER_LONG_TAP_MS
        int "Minimum duration in ms for a tap to count as a long tap"
        default 2000
        help
            Minimum time an RFID tag must stay present on the reader for the
            tap to be treated as a checkout (long tap) instead of a
            confirm/extend (short tap).

    config ID_MANAGER_MIN_USE_BEFORE_EXTEND_MIN
        int "Minimum minutes of use before an extend tap is accepted"
        default 60
        help
            A short tap while the workstation is in FIRST_USE is only
            accepted as an extend once this many minutes have passed since
            start_time.

    config ID_MANAGER_CONFIRM_TIMEOUT_MIN
        int "Minutes to wait for a confirmation tap after a schedule is loaded"
        default 5
        help
            If no confirm tap happens within this many minutes after a
            SCHEDULE_CMD_LOAD, the id_manager automatically checks out the
            pending reservation, freeing the queue.

    config ID_MANAGER_FETCH_INTERVAL_SEC
        int "Seconds between periodic schedule fetches"
        default 60
        help
            Interval between GET /api/schedule polls performed by the
            id_manager thread.

    config ID_MANAGER_SUB_QUEUE_SIZE
        int "id_manager zbus subscriber queue size"
        default 4
        help
            Number of pending zbus notifications the id_manager subscriber
            can hold before older ones are dropped.

    config ID_MANAGER_THREAD_STACK_SIZE
        int "id_manager thread stack size"
        default 2048

    config ID_MANAGER_THREAD_PRIORITY
        int "id_manager thread priority"
        default 5
endmenu
```

## Kconfig.led
```kconfig
module = LED
module-str = led
source "subsys/logging/Kconfig.template.log_config"

menu "Led service"
    config LED_CMD_SUB_QUEUE_SIZE
        int "Size of the LED command subscription queue."
        default 2

    config LED_BLINK_TIME_SLOW_MS
      int "LED time to slow interval in milliseconds"
      default 800

    config LED_BLINK_TIME_FAST_MS
      int "LED time to fast interval in milliseconds"
      default 200

    config LED_THREAD_STACK_SIZE
      int "LED thread stack size"
      default 256
      help
        Set the stack size for the LED thread.
        This value determines the amount of stack memory allocated for the LED thread.

    config LED_THREAD_PRIORITY
      int "LED thread priority"
      default 7
      help
        Set the priority for the LED thread.
        This value determines the scheduling priority of the LED thread.
endmenu
```

## Kconfig.rfid
```kconfig
module = RFID_SERVICE
module-str = rfid_service
source "subsys/logging/Kconfig.template.log_config"

menu "RFID service"
    config RFID_THREAD_STACK_SIZE
        int "RFID thread stack size."
        default 1024
        help
            Set the stack size for the RFID thread.
            This value determines the amount of stack memory allocated for the RFID thread.

    config RFID_THREAD_PRIORITY
        int "RFID thread priority."
        default 5
        help
            Set the priority for the RFID thread.
            This value determines the scheduling priority of the RFID thread.

    config MFRC522_UID_MAX_LEN
        int "Maximum length of MFRC522 UID."
        default 10
        help
            Set the maximum length for the MFRC522 UID.

    config RFID_POLL_INTERVAL_MS
        int "RFID poll interval in milliseconds."
        default 200
        help
            Delay between successive sensor_sample_fetch() calls in the RFID thread loop.
endmenu
```

## Kconfig.schedule
```kconfig
module = SCHEDULE
module-str = schedule
source "subsys/logging/Kconfig.template.log_config"

menu "Schedule"
    config MAX_ID_LENGTH
        int "Max number of characters in an ID"
        default 16
        help
            Maximum number of characters allowed in a User ID.

    config SCHEDULE_FIRST_USE_TIMEOUT_MINUTES
        int "Timeout in minutes for a workstation's first use"
        default 120
        help
            Number of minutes before a workstation's initial reservation times out.

    config SCHEDULE_EXTEND_TIMEOUT_MINUTES
        int "Timeout in minutes for a workstation's extend command"
        default 60
        help
            Number of minutes added when a workstation reservation is extended.
endmenu
```

## Kconfig.settings
```kconfig
menu "Settings and shell modules"
    config SHELL_HTTP
        bool "Enable HTTP shell commands"
        default n
        help
            Enable HTTP shell commands for the application.
    config SHELL_LED
        bool "Enable LED shell commands"
        default n
        help
            Enable LED shell commands for the application.
    config SHELL_STORAGE
        bool "Enable Storage shell commands"
        default n
        help
            Enable Storage shell commands for the application.
    config SHELL_WIFI
        bool "Enable Wi-Fi shell commands"
        default n
        help
            Enable Wi-Fi shell commands for the application.

    config SHELL_SETTINGS
        bool "Enable shell settings commands"
        default n
        help
            Enable shell commands for managing application settings.
endmenu
```

## Kconfig.sntp
```kconfig
menu "SNTP service configuration"
    config SNTP_SERVICE_SERVER
        string "SNTP server hostname"
        default "pool.ntp.org"
        help
          Hostname or IP address of the SNTP server to query for time synchronization.

    config SNTP_SERVICE_TIMEOUT_MS
        int "SNTP request timeout (ms)"
        default 5000
        help
          Timeout in milliseconds for a single SNTP request.

    config SNTP_SERVICE_RETRY_INTERVAL_MS
        int "SNTP retry interval on failure (ms)"
        default 30000
        help
          Time to wait before retrying after a failed SNTP sync while still connected.

    config SNTP_SERVICE_THREAD_STACK_SIZE
        int "SNTP service thread stack size"
        default 3072
        help
          Stack size for the SNTP service thread. SNTP uses network sockets, so this
          must be larger than a typical service thread.

    config SNTP_SERVICE_THREAD_PRIORITY
        int "SNTP service thread priority"
        default 6
        help
          Priority for the SNTP service thread.

    config SNTP_SERVICE_WIFI_SUB_QUEUE_SIZE
        int "SNTP service WiFi state subscriber queue size"
        default 4
        help
          ZBus subscriber queue depth for WiFi state notifications in the SNTP service.

    config SNTP_SERVICE_UTC_OFFSET
        int "UTC offset in seconds"
        default -10800
        help
          Offset from UTC in seconds applied when logging local time.
          Brazil (BRT) = -10800 (UTC-3). No DST adjustment is performed.
endmenu

module = SNTP_SERVICE
module-str = sntp_service
source "subsys/logging/Kconfig.template.log_config"
```

## Kconfig.storage
```kconfig
module = STORAGE
module-str = storage
source "subsys/logging/Kconfig.template.log_config"

menu "Storage"
    config FLASH_INIT_PRIORITY
        int "Priority of flash initialization."
        default 50
        help
            Set the priority of the flash initialization.
            Lower values have higher priority and are initialized first.
endmenu
```

## Kconfig.wifi
```kconfig
menu "Wi-Fi configuration"
    config WIFI_SSID_MAX_LEN
        int "Maximum length of Wi-Fi SSID"
        default 32
        help
          This option sets the maximum length of Wi-Fi SSID that can be stored in the system. 
          The default value is 32 characters, which is the maximum length defined by the IEEE 802.11 standard for SSID.

    config WIFI_PSK_MAX_LEN
        int "Maximum length of Wi-Fi PSK"
        default 64
        help
          This option sets the maximum length of Wi-Fi Pre-Shared Key (PSK) that can be stored in the system. 
          The default value is 64 characters, which is the maximum length defined by the IEEE 802.11 standard for WPA2-PSK.

    config WIFI_THREAD_STACK_SIZE
        int "Wi-Fi thread stack size"
        default 2048
        help
          This option sets the stack size for the Wi-Fi thread. 
          The default value is 2048 bytes, which should be sufficient for most Wi-Fi operations. 
          Adjust this value if you encounter stack overflow issues or if your application requires more stack space for Wi-Fi operations.

    config WIFI_THREAD_PRIORITY
        int "Wi-Fi thread priority"
        default 5
        help
          This option sets the priority for the Wi-Fi thread. 
          The default value is 5, which is a moderate priority level. 
          Adjust this value based on the requirements of your application and the priorities of other threads in your system.

    config WIFI_CMD_SUB_QUEUE_SIZE
        int "Wi-Fi zbubs command queue size of subscribers"
        default 4
        help
          This option sets the size of the sub-queue for Wi-Fi commands. 
          The default value is 10, which should be sufficient for most applications. 
          Adjust this value if you encounter issues with command processing or if your application requires a larger or smaller queue.

    config WIFI_SHELL_MONITOR_POLL_MS
        int "Wi-Fi shell monitor poll interval (ms)"
        default 500
        help
          This option sets the poll interval for the Wi-Fi shell monitor command. 
          The default value is 500 ms, which provides a good balance between responsiveness and system load.

    config WIFI_SHELL_MONITOR_TIMEOUT
        int "Wi-Fi shell monitor timeout (iterations)"
        default 120
        help
          This option sets the timeout for the Wi-Fi shell monitor command. 
          The default value is 120 iterations, which corresponds to 60 seconds with the default poll interval.
endmenu

module = WIFI
module-str = wifi
source "subsys/logging/Kconfig.template.log_config"
```

## tests/integration/settings/testcase.yaml
```yaml
tests:
  integration.settings:
    platform_allow:
      - qemu_x86
    tags:
      - simulated
      - settings
      - integration
```

## tests/unit/schedule/testcase.yaml
```yaml
tests:
  unit.schedule:
    platform_allow:
      - qemu_x86
    tags:
      - simulated
      - schedule
      - unit
```

## tests/unit/sntp/testcase.yaml
```yaml
tests:
  unit.sntp:
    platform_allow:
      - native_sim
    tags:
      - simulated
      - sntp
      - unit
```

## tests/unit/storage/testcase.yaml
```yaml
tests:
  unit.storage:
    platform_allow:
      - qemu_x86
    tags:
      - simulated
      - storage
      - unit
```

## west.yml
```yaml
manifest:
  version: "0.13"

  remotes:
    - name: zephyrproject-rtos
      url-base: https://github.com/zephyrproject-rtos

  projects:
    - name: zephyr
      remote: zephyrproject-rtos
      revision: v4.4.0
      import:
        name-allowlist:
          - hal_espressif
          - lvgl
          - mbedtls
          - tf-psa-crypto
```
