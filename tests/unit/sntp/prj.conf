## CMakeLists.txt
```
cmake_minimum_required(VERSION 3.20.0)
find_package(Zephyr REQUIRED HINTS $ENV{ZEPHYR_BASE})

include(../unit.cmake)

project(sntp_unit_test)

target_sources(app PRIVATE
    src/main.c
    src/stubs.c
    ${CMAKE_CURRENT_SOURCE_DIR}/../../../src/services/sntp.c
)

target_include_directories(app PRIVATE
    ${CMAKE_CURRENT_SOURCE_DIR}/../../../includes
)

target_compile_definitions(app PRIVATE _POSIX_C_SOURCE=200809L)
```

## Kconfig
```
menu "Zephyr"
source "Kconfig.zephyr"
endmenu

rsource "../../../Kconfig.wifi"
rsource "../../../Kconfig.sntp"
```

## prj.conf
```kconfig
CONFIG_ZTEST=y
CONFIG_ZTEST_STACK_SIZE=4096

# ZBus
CONFIG_ZBUS=y

# Networking (required to compile sntp.c which includes <zephyr/net/sntp.h>)
CONFIG_NETWORKING=y
CONFIG_NET_TEST=y
CONFIG_NET_L2_DUMMY=y
CONFIG_NET_IPV4=y
CONFIG_NET_IPV6=n
CONFIG_NET_UDP=y
CONFIG_NET_SOCKETS=y
CONFIG_DNS_RESOLVER=y
CONFIG_ENTROPY_GENERATOR=y
CONFIG_TEST_RANDOM_GENERATOR=y

# SNTP library disabled — stubs.c provides sntp_simple directly so there is
# no symbol conflict and no real network call is ever made.
CONFIG_SNTP=n

# POSIX timers (for clock_settime in sntp.c)
CONFIG_POSIX_TIMERS=y

# Short retry interval so failure-path tests complete quickly
CONFIG_SNTP_SERVICE_RETRY_INTERVAL_MS=100

# Logging — silence the service to keep test output clean
CONFIG_LOG=y
CONFIG_SNTP_SERVICE_LOG_LEVEL_OFF=y

# Minimal net buffers
CONFIG_NET_PKT_RX_COUNT=4
CONFIG_NET_PKT_TX_COUNT=4
CONFIG_NET_BUF_RX_COUNT=8
CONFIG_NET_BUF_TX_COUNT=8

CONFIG_POSIX_TIMERS=y
```

## src/main.c
```c
/*
 * Unit tests for the SNTP service.
 * Platform: native_sim (sntp_simple is wrapped — no real network requests).
 *
 * The service thread starts automatically via K_THREAD_DEFINE in sntp.c.
 * Tests publish to wifi_state_chan and observe sntp_time_chan.
 *
 */

#include <zephyr/kernel.h>
#include <zephyr/zbus/zbus.h>
#include <zephyr/ztest.h>

#include "services/wifi.h"
#include "services/sntp.h"

/* Declared in stubs.c */
void stub_sntp_configure(int result, uint64_t seconds);
void stub_sntp_reset(void);
int stub_sntp_get_call_count(void);

/* Time to wait after publishing to wifi_state_chan for the service thread to
 * process the event and publish to sntp_time_chan. The stub is instant, so
 * 300 ms is a large safety margin. */
#define SYNC_WAIT_MS 300

static void publish_wifi_state(enum wifi_baiatool_state state)
{
	struct wifi_state_msg msg = {.state = state};
	int ret;

	ret = zbus_chan_pub(&wifi_state_chan, &msg, K_MSEC(100));
	zassert_ok(ret, "wifi_state_chan pub failed: %d", ret);
}

static void reset_sntp_time_chan(void)
{
	struct sntp_service_time_msg reset = {.unix_time_s = 0U, .valid = false};
	int ret;

	ret = zbus_chan_pub(&sntp_time_chan, &reset, K_MSEC(100));
	zassert_ok(ret, "sntp_time_chan reset failed: %d", ret);
}

static void before_each(void *fixture)
{
	ARG_UNUSED(fixture);

	/* Publishing DISCONNECTED breaks any ongoing retry loop: the retry loop
	 * reads wifi_state_chan on each iteration and exits when not CONNECTED. */
	publish_wifi_state(WIFI_BAIATOOL_STATE_DISCONNECTED);

	/* Wait long enough for the retry loop (100 ms interval) to notice the
	 * DISCONNECTED state and for the service thread to return to sub_wait. */
	k_msleep(250);

	/* Reset after the wait so any stub calls during cleanup are not counted. */
	stub_sntp_reset();
	reset_sntp_time_chan();
}

ZTEST_SUITE(sntp_service, NULL, NULL, before_each, NULL, NULL);

ZTEST(sntp_service, test_connected_publishes_valid_time)
{
	struct sntp_service_time_msg msg;

	stub_sntp_configure(0, 1750000000ULL);
	publish_wifi_state(WIFI_BAIATOOL_STATE_CONNECTED);
	k_msleep(SYNC_WAIT_MS);

	zassert_ok(zbus_chan_read(&sntp_time_chan, &msg, K_NO_WAIT),
		   "sntp_time_chan read failed");
	zassert_true(msg.valid, "expected valid=true after successful SNTP sync");
	zassert_equal(msg.unix_time_s, 1750000000ULL,
		      "unix_time_s mismatch: got %llu", (unsigned long long)msg.unix_time_s);
}

ZTEST(sntp_service, test_connected_calls_sntp_simple_once)
{
	stub_sntp_configure(0, 1750000000ULL);
	publish_wifi_state(WIFI_BAIATOOL_STATE_CONNECTED);
	k_msleep(SYNC_WAIT_MS);

	zassert_equal(stub_sntp_get_call_count(), 1,
		      "expected 1 sntp_simple call, got %d", stub_sntp_get_call_count());
}

ZTEST(sntp_service, test_disconnected_does_not_trigger_sync)
{
	struct sntp_service_time_msg msg;

	publish_wifi_state(WIFI_BAIATOOL_STATE_DISCONNECTED);
	k_msleep(SYNC_WAIT_MS);

	zassert_equal(stub_sntp_get_call_count(), 0,
		      "expected 0 sntp_simple calls on disconnect, got %d",
		      stub_sntp_get_call_count());

	zassert_ok(zbus_chan_read(&sntp_time_chan, &msg, K_NO_WAIT),
		   "sntp_time_chan read failed");
	zassert_false(msg.valid, "expected valid=false: no sync should occur on disconnect");
}

ZTEST(sntp_service, test_sntp_failure_publishes_invalid_time)
{
	struct sntp_service_time_msg msg;

	stub_sntp_configure(-EIO, 0ULL);
	publish_wifi_state(WIFI_BAIATOOL_STATE_CONNECTED);
	k_msleep(SYNC_WAIT_MS);

	zassert_ok(zbus_chan_read(&sntp_time_chan, &msg, K_NO_WAIT),
		   "sntp_time_chan read failed");
	zassert_false(msg.valid, "expected valid=false after SNTP request failure");
}

ZTEST(sntp_service, test_reconnect_triggers_second_sync)
{
	stub_sntp_configure(0, 1750000000ULL);

	publish_wifi_state(WIFI_BAIATOOL_STATE_CONNECTED);
	k_msleep(SYNC_WAIT_MS);

	publish_wifi_state(WIFI_BAIATOOL_STATE_DISCONNECTED);
	k_msleep(50);

	publish_wifi_state(WIFI_BAIATOOL_STATE_CONNECTED);
	k_msleep(SYNC_WAIT_MS);

	zassert_equal(stub_sntp_get_call_count(), 2,
		      "expected 2 sntp_simple calls across two connections, got %d",
		      stub_sntp_get_call_count());
}
```

## src/stubs.c
```c
#include <zephyr/kernel.h>
#include <zephyr/net/sntp.h>
#include <zephyr/zbus/zbus.h>

#include "services/wifi.h"
#include "services/sntp.h"

ZBUS_OBS_DECLARE(sntp_wifi_state_sub);

ZBUS_CHAN_DEFINE(wifi_state_chan, struct wifi_state_msg, NULL, NULL,
		 ZBUS_OBSERVERS(sntp_wifi_state_sub),
		 ZBUS_MSG_INIT(.state = WIFI_BAIATOOL_STATE_DISCONNECTED));

ZBUS_CHAN_DEFINE(wifi_cmd_chan, struct wifi_cmd_msg, NULL, NULL, ZBUS_OBSERVERS_EMPTY,
		 ZBUS_MSG_INIT(.type = WIFI_CMD_DISCONNECT));


static int stub_result;
static uint64_t stub_seconds;
static int stub_call_count;

void stub_sntp_configure(int result, uint64_t seconds)
{
	stub_result = result;
	stub_seconds = seconds;
}

void stub_sntp_reset(void)
{
	stub_result = 0;
	stub_seconds = 1750000000ULL;
	stub_call_count = 0;
}

int stub_sntp_get_call_count(void)
{
	return stub_call_count;
}

int sntp_simple(const char *server, uint32_t timeout, struct sntp_time *ts)
{
	ARG_UNUSED(server);
	ARG_UNUSED(timeout);

	stub_call_count++;

	if (stub_result < 0) {
		return stub_result;
	}

	ts->seconds = stub_seconds;
	ts->fraction = 0U;
	ts->rsp_delay_us = 0U;

	return 0;
}
```
